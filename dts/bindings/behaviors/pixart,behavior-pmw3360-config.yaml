## dts/bindings/behaviors/pixart,behavior-pmw3360-config.yaml
```yaml
# SPDX-License-Identifier: MIT

description: Runtime PMW3360 configuration behavior
compatible: "pixart,behavior-pmw3360-config"

include: one_param.yaml
```

## dts/bindings/pixart,pmw3360.yml
```yaml
description: |
  Sensor driver for the PixArt PMW3360 mouse sensor.
  It uses the standard QMK-style 4-wire SPI interface: CS, SCLK, MOSI, and MISO.

compatible: "pixart,pmw3360"

include: spi-device.yaml

properties:
  irq-gpios:
    type: phandle-array
    required: false
  scroll-layers:
    type: array
    default: []
  snipe-layers:
    type: array
    default: []
  automouse-layer:
    type: int
    default: -1
```
